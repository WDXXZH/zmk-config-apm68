## Kconfig
```kconfig
# Copyright (c) 2024 APM68 Keyboard
# SPDX-License-Identifier: MIT

rsource "drivers/Kconfig"
```

## boards/others/apm32_f103c8/Kconfig.apm32_f103c8
```kconfig
# SPDX-License-Identifier: MIT

config BOARD_APM32_F103C8
	select SOC_STM32F103XB
	select ZMK_BOARD_COMPAT if BOARD_APM32_F103C8_STM32F103XB_ZMK
```

## boards/others/apm32_f103c8/Kconfig.defconfig
```kconfig
# SPDX-License-Identifier: MIT

if BOARD_APM32_F103C8

config BOARD
	default "apm32_f103c8"

config ZMK_BOARD_COMPAT
	default y

endif # BOARD_APM32_F103C8
```

## boards/others/apm32_f103c8/apm32_f103c8_zmk_defconfig
```kconfig
# SPDX-License-Identifier: MIT

# Enable MPU
CONFIG_ARM_MPU=y

# System clock 72MHz
CONFIG_SYS_CLOCK_HW_CYCLES_PER_SEC=72000000

# Enable reset by default
CONFIG_RESET=y

# Enable clock control
CONFIG_CLOCK_CONTROL=y

# Code partition needed to target the correct flash range
CONFIG_USE_DT_CODE_PARTITION=y

# USB HID
CONFIG_ZMK_USB=y

# Enable GPIO
CONFIG_GPIO=y

# Defaults for matrix scanning to avoid interrupt issues
CONFIG_ZMK_KSCAN_MATRIX_POLLING=y

# Enable HW stack protection
CONFIG_HW_STACK_PROTECTION=y

# Flash and settings
CONFIG_FLASH=y
CONFIG_FLASH_PAGE_LAYOUT=y
CONFIG_FLASH_MAP=y
CONFIG_NVS=y
CONFIG_SETTINGS_NVS=y
CONFIG_MPU_ALLOW_FLASH_WRITE=y

# Serial console (for debugging)
CONFIG_SERIAL=y
CONFIG_CONSOLE=y
CONFIG_UART_CONSOLE=y

# Pin controller
CONFIG_PINCTRL=y
```

## boards/others/apm32_f103c8/board.yml
```yaml
board:
  name: apm32_f103c8
  vendor: others
  socs:
  - name: stm32f103xb
    variants:
    - name: zmk
```

## drivers/led_strip/Kconfig
```kconfig
# Copyright (c) 2024 APM68 Keyboard
# SPDX-License-Identifier: MIT

config LED_STRIP_WS2812_STM32
	bool "WS2812 LED strip driver for STM32 (GPIO bit-bang)"
	depends on DT_HAS_WORLDSEMI_WS2812_STM32_ENABLED
	depends on GPIO
	help
	  Enable the WS2812 bit-bang LED strip driver for STM32/APM32
	  devices. Uses the DWT cycle counter for timing on Cortex-M.
```

## dts/bindings/led_strip/worldsemi,ws2812-stm32.yaml
```yaml
# Copyright (c) 2024 APM68 Keyboard
# SPDX-License-Identifier: MIT

description: |
  Worldsemi WS2812 LED strip, STM32 GPIO bit-bang driver.
  Custom driver for STM32F103/APM32F103 that bit-bangs the WS2812
  protocol on a GPIO using the DWT cycle counter for timing.

compatible: "worldsemi,ws2812-stm32"

properties:
  gpios:
    type: phandle-array
    required: true
    description: |
      GPIO phandle and specifier for the pin connected to the
      LED strip data line. Exactly one pin should be given.

  chain-length:
    type: int
    required: true
    description: |
      The number of devices in the daisy-chain.

  color-mapping:
    type: array
    required: true
    description: |
      Channel to color mapping (or pixel order).
      For example a GRB channel to color mapping would be:
      color-mapping = <LED_COLOR_ID_GREEN
                       LED_COLOR_ID_RED
                       LED_COLOR_ID_BLUE>;

  reset-delay:
    type: int
    default: 50
    description: |
      Minimum delay to wait (in microseconds) to make sure that the
      strip has latched the signal.
```
